#include "project_include.h"

#ifndef OLED_USE_SOLGUI

const u8 F6x8[][6] ={
	0x00, 0x00, 0x00, 0x00, 0x00, 0x00,// sp
	0x00, 0x00, 0x00, 0x2f, 0x00, 0x00,// !
	0x00, 0x00, 0x07, 0x00, 0x07, 0x00,// "
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	0x14, 0x14, 0x14, 0x14, 0x14, 0x14,// hirozy line
	};

#endif

//##############################用户函数##############################
//------------引脚初始化函数

void OLED_PinInit()
{
	RCC->APB2ENR|=1<<3|1<<4;    		//使能PORTB,PORTC时钟          

#if SPI_CK_Pin/8				//CK										
		SPI_CK_GPIOx->CRH&=~((u32)0xf<<((SPI_CK_Pin%8)*4));		
		SPI_CK_GPIOx->CRH|=(u32)0x3<<((SPI_CK_Pin%8)*4);
#else
		SPI_CK_GPIOx->CRL&=~((u32)0xf<<((SPI_CK_Pin%8)*4));
		SPI_CK_GPIOx->CRL|=(u32)0x3<<((SPI_CK_Pin%8)*4);
#endif

#if SPI_DI_Pin/8				//DI										
		SPI_DI_GPIOx->CRH&=~((u32)0xf<<((SPI_DI_Pin%8)*4));
		SPI_DI_GPIOx->CRH|=(u32)0x3<<((SPI_DI_Pin%8)*4);
#else
		SPI_DI_GPIOx->CRL&=~((u32)0xf<<((SPI_DI_Pin%8)*4));
		SPI_DI_GPIOx->CRL|=(u32)0x3<<((SPI_DI_Pin%8)*4);
#endif

#if SPI_RST_Pin/8				//RST										
		SPI_RST_GPIOx->CRH&=~((u32)0xf<<((SPI_RST_Pin%8)*4));
		SPI_RST_GPIOx->CRH|=(u32)0x3<<((SPI_RST_Pin%8)*4);
#else
		SPI_RST_GPIOx->CRL&=~((u32)0xf<<((SPI_RST_Pin%8)*4));
		SPI_RST_GPIOx->CRL|=(u32)0x3<<((SPI_RST_Pin%8)*4);
#endif

#if SPI_DC_Pin/8				//DC										
		SPI_DC_GPIOx->CRH&=~((u32)0xf<<((SPI_DC_Pin%8)*4));
		SPI_DC_GPIOx->CRH|=(u32)0x3<<((SPI_DC_Pin%8)*4);
#else
		SPI_DC_GPIOx->CRL&=~((u32)0xf<<((SPI_DC_Pin%8)*4));
		SPI_DC_GPIOx->CRL|=(u32)0x3<<((SPI_DC_Pin%8)*4);
#endif
 
}

//##############################系统函数##############################
void OLED_WrDat(u8 dat)
{
	u8 i=8;
	OLED_DC_HIGH();
	OLED_CK_LOW();
	while(i--)
	{
		if(dat&0x80){
			OLED_DI_HIGH();
		}
		else{
			OLED_DI_LOW();
		}
		OLED_CK_HIGH();      
		OLED_CK_LOW();
		dat<<=1;    
	}
}

void OLED_WrCmd(u8 cmd)
{
	u8 i=8;
	OLED_DC_LOW();
	OLED_CK_LOW();
	while(i--)
	{
		if(cmd&0x80)
		{
			OLED_DI_HIGH();
		}
		else
		{
			OLED_DI_LOW();
		}
		OLED_CK_HIGH();      
		OLED_CK_LOW(); 
		cmd<<=1;  
	} 	
}

void OLED_Set_Pos(u8 x, u8 y)
{ 
	OLED_WrCmd(0xb0+y);
	OLED_WrCmd(((x&0xf0)>>4)|0x10);
	OLED_WrCmd((x&0x0f)|0x00); 
} 
void OLED_Fill(u8 bmp_dat)
{
	u8 y,x;
	
	for(y=0;y<8;y++)
	{
		OLED_WrCmd(0xb0+y);
		OLED_WrCmd(0x01);
		OLED_WrCmd(0x10);
		for(x=0;x<OLED_X_WIDTH;x++)
			OLED_WrDat(bmp_dat);
	}
}
void OLED_CLS(void)
{
	u8 y,x;	
	for(y=0;y<8;y++)
	{
		OLED_WrCmd(0xb0+y);
		OLED_WrCmd(0x01);
		OLED_WrCmd(0x10); 
		for(x=0;x<OLED_X_WIDTH;x++)
			OLED_WrDat(0);
	}
}

void OLED_Init(void)        
{
	OLED_PinInit();
	  
	OLED_CK_HIGH();	  	
	OLED_RST_LOW();
	OLED_Delay();

	OLED_RST_HIGH();

	OLED_WrCmd(0xae);//--turn off oled panel
	OLED_WrCmd(0x00);//---set low column address
	OLED_WrCmd(0x10);//---set high column address
	OLED_WrCmd(0x40);//--set start line address  Set Mapping RAM Display Start Line (0x00~0x3F)
	OLED_WrCmd(0x81);//--set contrast control register
	OLED_WrCmd(0xcf); // Set SEG Output Current Brightness
	OLED_WrCmd(0xa1);//--Set SEG/Column Mapping     0xa0左右反置 0xa1正常
	OLED_WrCmd(0xc8);//Set COM/Row Scan Direction   0xc0上下反置 0xc8正常
	OLED_WrCmd(0xa6);//--set normal display
	OLED_WrCmd(0xa8);//--set multiplex ratio(1 to 64)
	OLED_WrCmd(0x3f);//--1/64 duty
	OLED_WrCmd(0xd3);//-set display offset	Shift Mapping RAM Counter (0x00~0x3F)
	OLED_WrCmd(0x00);//-not offset
	OLED_WrCmd(0xd5);//--set display clock divide ratio/oscillator frequency
	OLED_WrCmd(0x80);//--set divide ratio, Set Clock as 100 Frames/Sec
	OLED_WrCmd(0xd9);//--set pre-charge period
	OLED_WrCmd(0xf1);//Set Pre-Charge as 15 Clocks & Discharge as 1 Clock
	OLED_WrCmd(0xda);//--set com pins hardware configuration
	OLED_WrCmd(0x12);
	OLED_WrCmd(0xdb);//--set vcomh
	OLED_WrCmd(0x40);//Set VCOM Deselect Level
	OLED_WrCmd(0x20);//-Set Page Addressing Mode (0x00/0x01/0x02)
	OLED_WrCmd(0x02);//
	OLED_WrCmd(0x8d);//--set Charge Pump enable/disable
	OLED_WrCmd(0x14);//--set(0x10) disable
	OLED_WrCmd(0xa4);// Disable Entire Display On (0xa4/0xa5)
	OLED_WrCmd(0xa6);// Disable Inverse Display On (0xa6/a7) 
	OLED_WrCmd(0xaf);//--turn on oled panel
	OLED_Fill(0x00);  //初始清屏
	OLED_Set_Pos(0,0); 	
} 

//######################【移植用】#########################


void OLED_FillScreen(u8 gram[OLED_X_WIDTH][OLED_Y_PAGE])		//整屏刷新（显存数组指针）
{
	int i=0,n=0;
	for(i=0;i<OLED_Y_PAGE;i++)
	{
		OLED_WrCmd(0xb0+i);
		OLED_WrCmd(0x00);
		OLED_WrCmd(0x10);
		for(n=0;n<OLED_X_WIDTH;n++)
		{
			OLED_WrDat(gram[n][i]);
		}
	}	
}

#ifndef OLED_USE_SOLGUI

void OLED_P6x8Str(u8 x,u8 y,u8 ch[]) //硬件写字符串:硬件测试
{
	unsigned char c=0,i=0,j=0;      
	while (ch[j]!='\0')
	{    
		c =ch[j]-32;
		if(x>126)
		{
			x=0;
			y++;
		}
		OLED_Set_Pos(x,y);    
		for(i=0;i<6;i++)
		{     
			OLED_WrDat(F6x8[c][i]);  
		}
		x+=6;
		j++;
	}
}

#endif








